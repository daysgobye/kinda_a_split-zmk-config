#include "wubbo_left.dts"

&ortho_transform {
 col-offset=<1>;
};

	&kscan {
		col-gpios
			= <&gpio0 8 (GPIO_ACTIVE_HIGH)>
			, <&gpio0 11 (GPIO_ACTIVE_HIGH)>
			, <&gpio1 8 (GPIO_ACTIVE_HIGH)>
			, <&gpio0 6 (GPIO_ACTIVE_HIGH)>
			, <&gpio0 7 (GPIO_ACTIVE_HIGH)>
			, <&gpio0 26 (GPIO_ACTIVE_HIGH)>
			, <&gpio0 4 (GPIO_ACTIVE_HIGH)>
			, <&gpio0 12 (GPIO_ACTIVE_HIGH)>
			, <&gpio0 16 (GPIO_ACTIVE_HIGH)>
			, <&gpio1 9 (GPIO_ACTIVE_HIGH)>
			, <&gpio0 22 (GPIO_ACTIVE_HIGH)>
			, <&gpio1 0 (GPIO_ACTIVE_HIGH)>
			;
	};