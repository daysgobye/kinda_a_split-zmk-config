## config/boards/shield/technikable_dongle/Kconfig.defconfig
```kconfig
# Copyright (c) 2020 The ZMK Contributors
# SPDX-License-Identifier: MIT

if SHIELD_TECHNIKABLE_DONGLE

config ZMK_KEYBOARD_NAME
	default "Wubbo"
	
config ZMK_SPLIT_BLE_ROLE_CENTRAL
	default y
	
config ZMK_USB
	default y

config ZMK_SPLIT
	default y

config ZMK_BLE
	default y
	
endif
```

## config/boards/shield/technikable_dongle/Kconfig.shield
```kconfig
# technikable board configuration

# Copyright (c) 2021 Pete Johanson
# SPDX-License-Identifier: MIT

config BOARD_TECHNIKABLE
	def_bool $(shields_list_contains,technikable_dongle)
```
